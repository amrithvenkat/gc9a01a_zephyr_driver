## drivers/Kconfig
```kconfig
# drivers configuration options

# Copyright (c) 2015 Intel Corporation
# SPDX-License-Identifier: Apache-2.0

menu "Drivers"
rsource "display/Kconfig"
endmenu
```

## dts/bindings/display/waveshare,gc9a01a.yaml
```yaml
# Copyright (c) 2018, Jan Van Winkel <jan.van_winkel@dxplore.eu>
# Copyright (c) 2020, Teslabs Engineering S.L.
# Copyright (c) 2023 Mr Beam Lasers GmbH.
# Copyright (c) 2023 Amrith Venkat Kesavamoorthi <amrith@mr-beam.org> 
# SPDX-License-Identifier: Apache-2.0

description: GC9A01A 240x240 circular display controller

compatible: "waveshare,gc9a01a"

include: [spi-device.yaml, display-controller.yaml]

properties:
    reset-gpios:
      type: phandle-array
      required: true
      description: RESET pin

        The RESET pin of the GC9A01A is active low.
        If connected directly the MCU pin should be configured
        as active low.
    
    cmd-data-gpios:
      type: phandle-array
      required: true
      description: Command/Data pin
        The Data/Command pin of the GC9A01A is to be configured
        high(1) for data, low(0) for command.

    pixel-format:
      type: int
      default: 0
      enum:
        - 0 # RGB565
        - 1 # RGB888
      description:
        Display pixel format. Note that when RGB888 pixel format is selected
        only 6 color bits are actually used being in practice equivalent to
        RGB666.

    rotation:
      type: int
      default: 0
      enum:
        - 0
        - 90
        - 180
        - 270
      description:
        Display rotation (CW) in degrees.
    
    display-inversion:
      type: boolean
      description:
        Display inversion mode. Every bit is inverted from the frame memory to
        the display.

    backlight-gpios:
      type: phandle
      required: true
      description: Display Backlight PWM setting

    regeb:
      type: uint8-array
      default: [0x14]
      description:
        Register EB.

    reg84:
      type: uint8-array
      default: [0x40]
      description:
        Register 84.
  
    reg85:
      type: uint8-array
      default: [0xff]
      description:
        Register 85.

    reg86:
      type: uint8-array
      default: [0xff]
      description:
        Register 86.

    reg87:
      type: uint8-array
      default: [0xff]
      description:
        Register 87.

    reg88:
      type: uint8-array
      default: [0x0a]
      description:
        Register 88.

    reg89:
      type: uint8-array
      default: [0x21]
      description:
        Register 89.

    reg8a:
      type: uint8-array
      default: [0x00]
      description:
        Register 8a.

    reg8b:
      type: uint8-array
      default: [0x80]
      description:
        Register 8b.

    reg8c:
      type: uint8-array
      default: [0x01]
      description:
        Register 8c.

    reg8d:
      type: uint8-array
      default: [0x01]
      description:
        Register 8d.

    reg8e:
      type: uint8-array
      default: [0xff]
      description:
        Register .

    reg8f:
      type: uint8-array
      default: [0xff]
      description:
        Register 8f.

    regb6:
      type: uint8-array
      default: [0x00 , 0x20]
      description:
        Register b6.

    reg90:
      type: uint8-array
      default: [0x08,0x08,0x08,0x08]
      description:
        Register reg90

    regbd:
      type: uint8-array
      default: [0x06]
      description:
        Register regbd

    regbc:
      type: uint8-array
      default: [0x00]
      description:
        Register regbc

    regff:
      type: uint8-array
      default: [0x60, 0x01, 0x04]
      description:
        Register regff

    regvreg1a:
      type: uint8-array
      default: [0x13]
      description:
        Register regvreg1a

    regvreg1b:
      type: uint8-array
      default: [0x13]
      description:
        Register regvreg1b

    regvreg2a:
      type: uint8-array
      default: [0x22]
      description:
        Register regvreg2a

    regbe:
      type: uint8-array
      default: [0x11]
      description:
        Register regbe

    reggmctrn1:
      type: uint8-array
      default: [0x10, 0x0E]
      description:
        Register reggmctrn1

    regdf:
      type: uint8-array
      default: [0x21, 0x0c, 0x02]
      description:
        Register regdf

    reggamma1:
      type: uint8-array
      default: [0x45, 0x09, 0x08, 0x08, 0x26, 0x2A]
      description:
        Register reggamma1

    reggamma2:
      type: uint8-array
      default: [0x43, 0x70, 0x72, 0x36, 0x37, 0x6F]
      description:
        Register reggamma2

    reggamma3:
      type: uint8-array
      default: [0x45, 0x09, 0x08, 0x08, 0x26, 0x2A]
      description:
        Register reggamma3

    reggamma4:
      type: uint8-array
      default: [ 0x43, 0x70, 0x72, 0x36, 0x37, 0x6F]
      description:
        Register reggamma4

    reged:
      type: uint8-array
      default: [0x1B, 0x0B]
      description:
        Register reged

    regae:
      type: uint8-array
      default: [0x77]
      description:
        Register regae

    regcd:
      type: uint8-array
      default: [0x63]
      description:
        Register regcd

    regframerate:
      type: uint8-array
      default: [0x34]
      description:
        Register regfr

    reg70:
      type: uint8-array
      default: [0x07, 0x07, 0x04, 0x0E, 0x0F, 0x09, 0x07, 0x08, 0x03]
      description:
        Register reg70

    reg62:
      type: uint8-array
      default: [0x18, 0x0D, 0x71, 0xED, 0x70, 0x70, 0x18, 0x0F, 0x71, 0xEF, 0x70, 0x70]
      description:
        Register reg62

    reg63:
      type: uint8-array
      default: [0x18, 0x11, 0x71, 0xF1, 0x70, 0x70, 0x18, 0x13, 0x71, 0xF3, 0x70, 0x70]
      description:
        Register reg63

    reg64:
      type: uint8-array
      default: [0x28, 0x29, 0xF1, 0x01, 0xF1, 0x00, 0x07]
      description:
        Register reg64

    reg66:
      type: uint8-array
      default: [0x3C, 0x00, 0xCD, 0x67, 0x45, 0x45, 0x10, 0x00, 0x00, 0x00]
      description:
        Register reg66

    reg67:
      type: uint8-array
      default: [0x00, 0x3C, 0x00, 0x00, 0x00, 0x01, 0x54, 0x10, 0x32, 0x98]
      description:
        Register reg67

    reg74:
      type: uint8-array
      default: [0x10, 0x85, 0x80, 0x00, 0x00, 0x4E, 0x00]
      description:
        Register reg74

    reg98:
      type: uint8-array
      default: [0x3e, 0x07]
      description:
        Register reg98
```

## sample.yaml
```yaml
sample:
  name: GC9A01A display driver
tests:
  # sample.basic.fade_led:
  #   tags: drivers pwm
  #   depends_on: pwm
  #   harness: led
  #   filter: dt_alias_exists("pwm-led0") and dt_compat_enabled("pwm-leds")
```
